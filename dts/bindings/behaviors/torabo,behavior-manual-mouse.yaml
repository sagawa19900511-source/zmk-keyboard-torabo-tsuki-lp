## dts/bindings/behaviors/torabo,behavior-manual-mouse.yaml
```yaml
description: Hold the Torabo mouse layer independently of the automatic timeout
compatible: "torabo,behavior-manual-mouse"
include: one_param.yaml
```

## dts/bindings/input_processors/torabo,ball-aml.yaml
```yaml
description: Torabo trackball automatic mouse layer
compatible: "torabo,ball-aml"
include: ip_two_param.yaml
```

## dts/bindings/input_processors/torabo,ball-scroll-inertia.yaml
```yaml
description: Cancellable scroll inertia for the left trackball's scroll layer
compatible: "torabo,ball-scroll-inertia"
include: ip_one_param.yaml
properties:
  enabled:
    type: int
    default: 1
    enum: [0, 1]
```
