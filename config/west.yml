## config/west.yml
```yaml
manifest:
  remotes:
    - name: zmkfirmware
      url-base: https://github.com/zmkfirmware
    - name: sekigon-gonnoc
      url-base: https://github.com/sekigon-gonnoc
  projects:
    - name: zmk
      remote: zmkfirmware
      revision: v0.3
      import: app/west.yml
    - name: zmk-component-bmp-boost
      remote: sekigon-gonnoc
      import: west.yml
      revision: 7dc3f9e4d344db0d1916170ac1a87a937dd717d9 # v0.2, diagnostic baseline
    - name: zmk-feature-status-led
      remote: sekigon-gonnoc
      revision: 572d0e16ecdd6b6d57e96461643cc55e7b9164d3 # main, diagnostic baseline
    - name: zmk-driver-paw3222
      remote: sekigon-gonnoc
      revision: 0e1835c57f88d215ce401b6d0901f361629621fc # torabo-tsuki, diagnostic baseline
    - name: zmk-driver-iqs7211e
      remote: sekigon-gonnoc
      revision: 436d3c42172abf812ec104521f29384fc02fc50e # original default revision
    - name: zmk-feature-cdc-acm-bootloader-trigger
      remote: sekigon-gonnoc
      revision: 3fc210f840433bb9204a510f3a2c78b4fa11482f # v0.2, diagnostic baseline
    - name: zmk-feature-non-lipo-battery-management
      remote: sekigon-gonnoc
      revision: 43fa56fb7d1e065393e926b6caa0ea02cb86eca7 # main, diagnostic baseline
  self:
    path: config
```

## dts/bindings/input_processors/torabo,mini-scroll-inertia.yaml
```yaml
description: Right mini trackpad Central-only cancellable 2D scroll inertia
compatible: "torabo,mini-scroll-inertia"
include: ip_one_param.yaml
properties:
  enabled:
    type: int
    default: 1
    enum: [0, 1]
```
